## conf/distro/include/ros-common.inc
```bitbake
# OE DISTRO configuration settings common to both ROS 1 and ROS 2 distros.
#
# Copyright (c) 2019 LG Electronics, Inc.

DISTRO_CODENAME = "${ROS_DISTRO}"
DISTRO_VERSION = "${ROS_DISTRO_METADATA_VERSION}"

MAINTAINER = "Open Source Robotics Foundation, Inc. <info@openrobotics.org>"

# Use systemd, but keep SysVinit present (see https://www.yoctoproject.org/docs/2.6.2/mega-manual/mega-manual.html#selecting-an-initialization-manager).
DISTRO_FEATURES_append = " systemd"
VIRTUAL-RUNTIME_init_manager = "systemd"

# ROS_DISTRO_BASELINE_PLATFORM is set in ros-distro.inc .
require conf/distro/include/${ROS_DISTRO_BASELINE_PLATFORM}/ros-distro-platform-preferred-providers.inc
require conf/distro/include/${ROS_DISTRO_BASELINE_PLATFORM}/ros-distro-platform-recipe-blacklist.inc
require conf/distro/include/${ROS_DISTRO_BASELINE_PLATFORM}/ros-distro-platform-preferred-versions.inc

# XXX Perhaps these below elsewhere?
PNBLACKLIST[webos-image-ros-roscore] ?= "Not buildable when DISTRO is '${DISTRO}'"
PNBLACKLIST[webos-image-ros-world] ?= "Not buildable when DISTRO is '${DISTRO}'"
```

## conf/distro/ros1.conf
```bitbake
DISTRO_NAME = "Robot Operating System (ROS)"

require conf/distro/include/ros-common.inc
```

## conf/distro/ros2.conf
```bitbake
DISTRO_NAME = "Robot Operating System 2 (ROS 2)"

require conf/distro/include/ros-common.inc

PNBLACKLIST[python] ?= "ROS 2 is Python 3 only"
```

## conf/layer.conf
```bitbake
# We have a conf and classes directory, append to BBPATH
BBPATH .= ":${LAYERDIR}"

# We have a recipes directory, add to BBFILES
BBFILES += "${LAYERDIR}/recipes-*/*/*.bb ${LAYERDIR}/recipes-*/*/*.bbappend"

BBFILE_COLLECTIONS += "ros-layer"
BBFILE_PATTERN_ros-layer := "^${LAYERDIR}/"
BBFILE_PRIORITY_ros-layer = "7"

LICENSE_PATH += "${LAYERDIR}/licenses"

LAYERVERSION_ros-layer = "2"

export ROS_DISTRO ?= "crystal"

# All generated recipes set this to "1".
ROS_SUPERFLORE_GENERATED ??= "0"

require conf/${ROS_DISTRO}/generated-ros-distro.conf
require conf/${ROS_DISTRO}/ros-distro.conf
require conf/${ROS_DISTRO}/blacklist.conf
require conf/${ROS_DISTRO}/preferred-versions.conf

# Only .bb files are generated
BBFILES += "${LAYERDIR}/generated-recipes-${ROS_DISTRO}/*/*.bb"

ROS_LAYERDIR := "${LAYERDIR}"

# Various ROS recipes depend on pkgconf, so we have to use it everywhere.
PREFERRED_PROVIDER_pkgconfig-native = "pkgconf-native"
```
